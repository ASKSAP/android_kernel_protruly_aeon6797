## drivers/fs16xx/Kconfig
```kconfig
#
# Smartpa  devices
#

menu "smartpa fs16xx device"
	depends on I2C

config FS16XX_SUPPORT
	tristate "support foursemi fs1601 chip"
	depends on I2C
	help
	 foursemi fs16xx driver

endmenu
```

## drivers/input/hall/Kconfig
```kconfig
config HALL_MTK
	tristate "MediaTek Hall Support"
  default n
	help
    CONFIG_HALL_MTK
```

## drivers/misc/mediatek/fingerprint/Kconfig
```kconfig
config MTK_FINGERPRINT_GOODIX_GFX1XM
       bool "goodix finger for MediaTek"
       default n
       help
          Goodix Fingerprint chip GF316M/GF516M/GF318M
```

## drivers/misc/mediatek/fingerprint_bf633x/Kconfig
```kconfig
config MTK_FINGERPRINT_BYD_BF633X
	tristate "Mediatek bf6637"
	default n
	---help---
	bf6637 mtk driver enable/disable in the kernel.
	Say Y here if you want to use mediatek fingerprint driver,
	fingerprint driver will support fingerprint function in REE,
	it supports mairuiwei's bf6637 device.
```

## drivers/misc/mediatek/fingerprint_gf368/Kconfig
```kconfig
config MTK_FINGERPRINT_GOODIX_GF368
       bool "goodix finger for MediaTek"
       default n
       help
          Goodix Fingerprint chip GF368
```

## drivers/misc/mediatek/fingerprint_sunwavecorp/Kconfig
```kconfig
config MTK_FINGERPRINT_SUNWAVECORP
       bool "SUNWAVECORP finger for MediaTek"
       default n
       help
          SUNWAVECORP Fingerprint
```

## drivers/misc/mediatek/tempsen/Kconfig
```kconfig
menuconfig MTK_TEMPSEN
	tristate "TEMPSEN drivers"
	default n
	---help---
	  Say Y here for supporting TEMPSEN.
	  Say Y here for supporting TEMPSEN.
	  Say Y here for supporting TEMPSEN.

if MTK_TEMPSEN

config TEMPSEN_MLX90615 # MTK_TEMPSEN
	tristate "MediaTek TEMPSEN driver"
	default n
	help
	  Y means MTK_TEMPSEN define if use Mediatek TEMPSEN Function to provide reader
	  Card emulation or P2P function. If you are not sure about this, set n.
	  Y means MTK_TEMPSEN define if use Mediatek TEMPSEN Function to provide reader
	  Card emulation or P2P function. If you are not sure about this, set n.
endif # TEMPSEN
```
