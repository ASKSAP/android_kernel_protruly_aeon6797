/dts-v1/;

#include "mt6797.dtsi"

#include <dt-bindings/lcm/r63419_wqhd_truly_phantom_2k_cmd_ok_mt6797.dtsi>

/ {
	memory@40000000 {
		device_type = "memory";
		reg = <0 0x40000000 0 0x1e605000>;
	};

	reserved-memory {
		#address-cells = <2>;
		#size-cells = <2>;
		ranges;

		memory-lowpower-reserved-memory {
			compatible = "mediatek,memory-lowpower";
			size = <0 0x60000000>;
			alloc-ranges = <0 0xc0000000 0 0x60000000>;
		};
	};

	/* chosen */
	chosen {
		bootargs = "console=tty0 console=ttyMT0,921600n1 root=/dev/ram initrd=0x44000000,0x4B434E loglevel=8";
		/* fpga may has no lk, we need to specify display info here */
		/* fb buffer is reserved using this dts by memory node above */
		atag,videolfb-fb_base_h = <0x0>;
		atag,videolfb-fb_base_l = <0x5e605000>;
		atag,videolfb-islcmfound = <1>;
		/* because no lk, so lcm is not inited */
		atag,videolfb-islcm_inited = <0>;
		atag,videolfb-fps= <6000>;
		atag,videolfb-vramSize= <0x017bb000>;
		atag,videolfb-lcmname= "r63419_wqhd_truly_phantom_2k_cmd_ok";
	};


	soc {
		compatible = "simple-bus";
		#address-cells = <1>;
		#size-cells = <1>;
		ranges = <0 0 0 0xffffffff>;

		i2c0@11007000 {
			bq24261@6b {
				compatible = "bq24261";
				reg = <0x6b>;
			};

			mt6306@64 {
				compatible = "mediatek,mt6306";
				reg = <0x64>;
			};
		};
		mmc0_pins_default: mmc0@default {
			pins_cmd {
				drive-strength = /bits/ 8 <1>;
			};
			pins_dat {
				drive-strength = /bits/ 8 <1>;
			};
			pins_clk {
				drive-strength = /bits/ 8 <1>;
			};
			pins_rst {
				drive-strength = /bits/ 8 <1>;
			};
			pins_ds {
				drive-strength = /bits/ 8 <1>;
			};
		};

		mmc0_register_setting_default: mmc0@register_default {
			dat0rddly      = /bits/ 8 <0>;
			dat1rddly      = /bits/ 8 <0>;
			dat2rddly      = /bits/ 8 <0>;
			dat3rddly      = /bits/ 8 <0>;
			dat4rddly      = /bits/ 8 <0>;
			dat5rddly      = /bits/ 8 <0>;
			dat6rddly      = /bits/ 8 <0>;
			dat7rddly      = /bits/ 8 <0>;
			datwrddly      = /bits/ 8 <0>;
			cmdrrddly      = /bits/ 8 <0>;
			cmdrddly       = /bits/ 8 <0>;
			cmd_edge = /bits/ 8 <MSDC_SMPL_FALLING>;
			rdata_edge = /bits/ 8 <MSDC_SMPL_FALLING>;
			wdata_edge = /bits/ 8 <MSDC_SMPL_FALLING>;
		};

		mmc1_pins_default: mmc1@default {
			   pins_cmd {
				   drive-strength = /bits/ 8 <6>;
			   };
			   pins_dat {
				   drive-strength = /bits/ 8 <6>;
			   };
			   pins_clk {
				   drive-strength = /bits/ 8 <6>;
			   };
		};

		mmc1_pins_sdr104: mmc1@sdr104 {
			  pins_cmd {
				  drive-strength = /bits/ 8 <3>;
			  };
			  pins_dat {
				  drive-strength = /bits/ 8 <3>;
			  };
			  pins_clk {
				  drive-strength = /bits/ 8 <4>;
			  };
		};

		mmc1_pins_sdr50: mmc1@sdr50 {
			 pins_cmd {
				 drive-strength = /bits/ 8 <3>;
			 };
			 pins_dat {
				 drive-strength = /bits/ 8 <3>;
			 };
			 pins_clk {
				 drive-strength = /bits/ 8 <4>;
			 };
		};

		mmc1_pins_ddr50: mmc1@ddr50 {
			 pins_cmd {
				 drive-strength = /bits/ 8 <3>;
			 };
			 pins_dat {
				 drive-strength = /bits/ 8 <3>;
			 };
			 pins_clk {
				 drive-strength = /bits/ 8 <4>;
			 };
		 };

		mmc1_register_setting_default: mmc1@register_default {
				       dat0rddly      = /bits/ 8 <0>;
				       dat1rddly      = /bits/ 8 <0>;
				       dat2rddly      = /bits/ 8 <0>;
				       dat3rddly      = /bits/ 8 <0>;
				       datwrddly      = /bits/ 8 <0>;
				       cmdrrddly      = /bits/ 8 <0>;
				       cmdrddly       = /bits/ 8 <0>;
				       cmd_edge = /bits/ 8 <MSDC_SMPL_FALLING>;
				       rdata_edge = /bits/ 8 <MSDC_SMPL_FALLING>;
				       wdata_edge = /bits/ 8 <MSDC_SMPL_FALLING>;
		};

	};

	led0:led@0 {
		compatible = "mediatek,red";
		led_mode = <3>;
		data = <1>;
		pwm_config = <0 0 0 0 0>;
	};
	led1:led@1 {
		compatible = "mediatek,green";
		led_mode = <3>;
		data = <2>;
		pwm_config = <0 0 0 0 0>;
	};
	led2:led@2 {
		compatible = "mediatek,blue";
		led_mode = <3>;
		data = <4>;
		pwm_config = <0 0 0 0 0>;
	};
	led3:led@3 {
		compatible = "mediatek,jogball-backlight";
		led_mode = <0>;
		data = <1>;
		pwm_config = <0 0 0 0 0>;
	};
	led4:led@4 {
		compatible = "mediatek,keyboard-backlight";
		led_mode = <0>;
		data = <1>;
		pwm_config = <0 0 0 0 0>;
	};
	led5:led@5 {
		compatible = "mediatek,button-backlight";
		led_mode = <0>;
		data = <1>;
		pwm_config = <0 0 0 0 0>;
	};
	led6:led@6 {
		compatible = "mediatek,lcd-backlight";
		led_mode = <5>;
		data = <1>;
		pwm_config = <0 0 0 0 0>;
	};
	vibrator0:vibrator@0 {
		compatible = "mediatek,vibrator";
		vib_timer = <25>;
		vib_limit = <9>;
		vib_vol= <5>;
	};
/* sensor standardization */
	cust_accel@0 {
		compatible				= "mediatek,bmi160_acc";
		i2c_num					= <1>;
		/* i2c_addr = <0x4c 0 0 0>; */
		direction				= <2>;
		power_id				= <0xffff>;
		power_vol				= <0>;
		firlen = <16>;
		is_batch_supported = <1>;
	};

	cust_alsps@0 {
		compatible = "mediatek,tl5601c";
		i2c_num	= <1>;
	/*	i2c_addr = <0x39 0 0 0>;  */
		polling_mode_ps = <0>;
		polling_mode_als = <1>;
		power_id = <0xffff>;
		power_vol = <0>;
		als_level  = <10  20 36 59 80 120 180 260 450 845 1136 1545 2364 4655 6982>;
                als_value  = <0 10 40 65 90 145 225 300 550 930 1250 1700 2600 5120 7680 10240>;
   	    state_val = <0x0>;		/* disable all */
		psctrl_val = <0x31>;		/* ps_persistance=4, ps_gain=64X, PS_IT=0.37ms */
		alsctrl_val = <0x38>;		/* als_persistance=1, als_gain=64X, ALS_IT=50ms */
		ledctrl_val = <0xFF>;	/* 100mA IRDR, 64/64 LED duty */
		wait_val = <0x7>;		/* 50 ms */
        ps_high_thd_val = <1700>;
        ps_low_thd_val = <1500>;	
		ps_threshold_high		=  <35>;
		ps_threshold_low		=  <30>;
		is_batch_supported_ps	= <0>;
		is_batch_supported_als	= <0>;
		};	

		cust_alsps_stk@0 {
		compatible = "mediatek,stk3x1x";
		i2c_num	= <1>;
	/*	i2c_addr = <0x48 0 0 0>;  */
		polling_mode_ps = <0>;
		polling_mode_als = <1>;
		power_id = <0xffff>;
		power_vol = <0>;
		als_level  = <1 20 36 59 80 120 180 260 450 845 1136 1545 2364 4655 6982>;
                als_value  = <0 225 225 550 550 550 550 930 930 930 930 2600 2600 5120 7680 10240>;
     	        state_val = <0x0>;		/* disable all */
		psctrl_val = <0x31>;		/* ps_persistance=4, ps_gain=64X, PS_IT=0.37ms */
		alsctrl_val = <0x38>;		/* als_persistance=1, als_gain=64X, ALS_IT=50ms */
		ledctrl_val = <0xFF>;	/* 100mA IRDR, 64/64 LED duty */
		wait_val = <0x7>;		/* 50 ms */
        ps_high_thd_val = <1700>;
        ps_low_thd_val = <1500>;	
		ps_threshold_high		=  <34>;
		ps_threshold_low		=  <28>;
		is_batch_supported_ps	= <0>;
		is_batch_supported_als	= <0>;
		};
		
		
	cust_mag@0 {
		compatible				= "mediatek,af7133E";
		i2c_num					= <1>;
		i2c_addr				= <0x1C 0 0 0>;
		direction				= <0>;
		power_id				= <0xffff>;
		power_vol				= <0>;
		is_batch_supported		= <0>;
	};

	cust_gyro@0 {
		compatible				= "mediatek,bmi160_gyro";
		i2c_num					= <1>;
		/* i2c_addr				= <0x6B 0 0 0>; */
		direction				= <2>;
		power_id				= <0xffff>;
		power_vol				= <0>;
		firlen					= <0>;
		is_batch_supported		= <0>;
	};

	cust_baro@0 {
		compatible				= "mediatek,bmp280";
		i2c_num					= <1>;
		i2c_addr				= <0x77 0 0 0>;
		direction				= <0>;
		power_id				= <0xffff>;
		power_vol				= <0>;
		firlen					= <0>;
		is_batch_supported		= <0>;
	};

	cust_hmdy@0 {
		compatible				= "mediatek,hts221";
		i2c_num					= <1>;
		i2c_addr				= <0x5f 0 0 0>;
		direction				= <0>;
		power_id				= <0xffff>;
		power_vol				= <0>;
		firlen					= <0>;
		is_batch_supported		= <0>;
	};
};
/* sensor gpio standization */
&pio {
	alsps_intpin_cfg: alspspincfg {

	    pins_cmd_dat {
			pins = <PINMUX_GPIO88__FUNC_EINT11>;
			slew-rate = <0>;
			bias-pull-up = <00>;
		};
	};

	alsps_intpin_default: alspsdefaultcfg {

	};

	gyro_intpin_cfg: gyropincfg {

	    pins_cmd_dat {
			pins = <PINMUX_GPIO65__FUNC_GPIO65>;
			slew-rate = <0>;
			bias-pull-down = <00>;
		};
	};

	gyro_intpin_default: gyrodefaultcfg {

	};
	hall_intpin_cfg: hallpincfg {

	    pins_cmd_dat {
			pins = <PINMUX_GPIO66__FUNC_GPIO66>;
			slew-rate = <0>;
			bias-pull-down = <00>;
		};
	};

	hall_intpin_default: halldefaultcfg {
	};
	
	homepage_intpin_cfg: homepagepincfg {

	    pins_cmd_dat {
			pins = <PINMUX_GPIO89__FUNC_GPIO89>;
			slew-rate = <0>;
			bias-pull-down = <00>;
		};
	};

	homepage_intpin_default: homepagedefaultcfg {
	};	
	
};
&als {
	pinctrl-names = "pin_default", "pin_cfg";
	pinctrl-0 = <&alsps_intpin_default>;
	pinctrl-1 = <&alsps_intpin_cfg>;
	status = "okay";

};

&gyro {
	pinctrl-names = "pin_default", "pin_cfg";
	pinctrl-0 = <&gyro_intpin_default>;
	pinctrl-1 = <&gyro_intpin_cfg>;
	status = "okay";

};
&hall_1 {
	pinctrl-names = "pin_default", "pin_cfg";
	pinctrl-0 = <&hall_intpin_default>;
	pinctrl-1 = <&hall_intpin_cfg>;
	status = "okay";

};

&homepage {
	pinctrl-names = "pin_default", "pin_cfg";
	pinctrl-0 = <&homepage_intpin_default>;
	pinctrl-1 = <&homepage_intpin_cfg>;
	status = "okay";

};

/* sensor end */
&apuart0 {
	/*
	pinctrl-names = "uart0_gpio_default",
			"uart0_rx_set",
			"uart0_rx_clear",
			"uart0_tx_set",
			"uart0_tx_clear";

	pinctrl-0 = <&uart0_gpio_def_cfg>;
	pinctrl-1 = <&uart0_rx_set_cfg>;
	pinctrl-2 = <&uart0_rx_clr_cfg>;
	pinctrl-3 = <&uart0_tx_set_cfg>;
	pinctrl-4 = <&uart0_tx_clr_cfg>;
	status = "okay";
	*/
};

&apuart1 {
	/*
	pinctrl-names = "uart1_gpio_default",
			"uart1_rx_set",
			"uart1_rx_clear",
			"uart1_tx_set",
			"uart1_tx_clear";

	pinctrl-0 = <&uart1_gpio_def_cfg>;
	pinctrl-1 = <&uart1_rx_set_cfg>;
	pinctrl-2 = <&uart1_rx_clr_cfg>;
	pinctrl-3 = <&uart1_tx_set_cfg>;
	pinctrl-4 = <&uart1_tx_clr_cfg>;
	status = "okay";
	*/
};

&pio {
	/* UART GPIO Settings - Start */
	/* UART0: rx set, rx clear, tx clear, tx clear*/
	/*
	uart0_gpio_def_cfg:uart0gpiodefault {
	};
	uart0_rx_set_cfg:uart0_rx_set@gpio97 {
		pins_cmd_dat {
			pins = <PINMUX_GPIO97__FUNC_URXD0>;
		};
	};
	uart0_rx_clr_cfg:uart0_rx_clear@gpio97  {
		pins_cmd_dat {
			pins = <PINMUX_GPIO97__FUNC_GPIO97>;
			slew-rate = <1>;
			output-high;
		};
	};
	uart0_tx_set_cfg:uart0_tx_set@gpio98  {
		pins_cmd_dat {
			pins = <PINMUX_GPIO98__FUNC_UTXD0>;
		};
	};
	uart0_tx_clr_cfg:uart0_tx_clear@gpio98  {
		pins_cmd_dat {
			pins = <PINMUX_GPIO98__FUNC_GPIO98>;
			slew-rate = <1>;
			output-high;
		};
	};
	*/
	/* UART1: rx set, rx clear, tx clear, tx clear*/
	/*
	uart1_gpio_def_cfg:uart1gpiodefault {
	};
	uart1_rx_set_cfg:uart1_rx_set@gpio232 {
		pins_cmd_dat {
			pins = <PINMUX_GPIO232__FUNC_URXD1>;
		};
	};
	uart1_rx_clr_cfg:uart1_rx_clear@gpio232 {
		pins_cmd_dat {
			pins = <PINMUX_GPIO232__FUNC_GPIO232>;
			slew-rate = <1>;
			output-high;
		};
	};
	uart1_tx_set_cfg:uart1_tx_set@gpio233 {
		pins_cmd_dat {
			pins = <PINMUX_GPIO233__FUNC_UTXD1>;
		};
	};
	uart1_tx_clr_cfg:uart1_tx_clear@gpio233 {
		pins_cmd_dat {
			pins = <PINMUX_GPIO233__FUNC_GPIO233>;
			slew-rate = <1>;
			output-high;
		};
	};
	*/
	/* UART GPIO Settings - End */
};


/* NFC GPIO standardization */
&pio {
	nfc_default: default {

	};

	nfc_ven_high: state_ven_high {
		pins_cmd_dat {
			pins = <PINMUX_GPIO60__FUNC_GPIO60>;
			slew-rate = <1>;
			output-high;
		};
	};

	nfc_ven_low: state_ven_low {
		pins_cmd_dat {
			pins = <PINMUX_GPIO60__FUNC_GPIO60>;
			slew-rate = <1>;
			output-low;
		};
	};

	nfc_rst_high: state_rst_high {
		pins_cmd_dat {
			pins = <PINMUX_GPIO59__FUNC_GPIO59>;
			slew-rate = <1>;
			output-high;
		};
	};

	nfc_rst_low: state_rst_low {
		pins_cmd_dat {
			pins = <PINMUX_GPIO59__FUNC_GPIO59>;
			slew-rate = <1>;
			output-low;
		};
	};

	nfc_eint_high: state_eint_high {
		pins_cmd_dat {
			pins = <PINMUX_GPIO57__FUNC_GPIO57>;
			slew-rate = <1>;
			output-high;
		};
	};

	nfc_eint_low: state_eint_low {
		pins_cmd_dat {
			pins = <PINMUX_GPIO57__FUNC_GPIO57>;
			slew-rate = <1>;
			output-low;
		};
	};

	nfc_irq_init: state_irq_init {
		pins_cmd_dat {
			pins = <PINMUX_GPIO58__FUNC_GPIO58>;
			slew-rate = <0>;
			bias-pull-down = <00>;
		};
	};

	nfc_osc_init: state_osc_init {
		pins_cmd_dat {
			pins = <PINMUX_GPIO100__FUNC_GPIO100>;
			slew-rate = <1>;
			bias-pull-down = <00>;
		};
	};

	spi_cs_low: state_cs_low {
		pins_cmd_dat {
			pins = <PINMUX_GPIO245__FUNC_GPIO245>;
			slew-rate = <1>;
			output-low;
			input-disable;
		};
	};

	spi_mo_low: state_mo_low {
		pins_cmd_dat {
			pins = <PINMUX_GPIO244__FUNC_GPIO244>;
			slew-rate = <1>;
			output-low;
			input-disable;
		};
	};

	spi_mi_low: state_mi_low {
		pins_cmd_dat {
			pins = <PINMUX_GPIO243__FUNC_GPIO243>;
			slew-rate = <1>;
			output-low;
			input-disable;
		};
	};

	spi_sck_low: state_sck_low {
		pins_cmd_dat {
			pins = <PINMUX_GPIO242__FUNC_GPIO242>;
			slew-rate = <1>;
			output-low;
			input-disable;
		};
	};
};

&nfc {
	pinctrl-names = "default", "ven_high", "ven_low", "rst_high", "rst_low",
	"eint_high", "eint_low", "irq_init", "osc_init", "cs_low", "mo_low",
	"mi_low", "sck_low";
	pinctrl-0 = <&nfc_default>;
	pinctrl-1 = <&nfc_ven_high>;
	pinctrl-2 = <&nfc_ven_low>;
	pinctrl-3 = <&nfc_rst_high>;
	pinctrl-4 = <&nfc_rst_low>;
	pinctrl-5 = <&nfc_eint_high>;
	pinctrl-6 = <&nfc_eint_low>;
	pinctrl-7 = <&nfc_irq_init>;
	pinctrl-8 = <&nfc_osc_init>;
	pinctrl-9 = <&spi_cs_low>;
	pinctrl-10 = <&spi_mo_low>;
	pinctrl-11 = <&spi_mi_low>;
	pinctrl-12 = <&spi_sck_low>;
	status = "okay";
};
/* NFC end */

&pio {
	iddig_default: iddig_default {
	};

	iddig_init: iddig_init {
		pins_cmd_dat {
			pins = <PINMUX_GPIO181__FUNC_IDDIG>;
			slew-rate = <0>;
			bias-pull-up = <00>;
		};
	};
};
	
&pio {
	drvvbus_default: drvvbus_default {
	};

	gpio43_mode1_drvvbus_low: drvvbus_low {
		pins_cmd_dat {
			pins = <PINMUX_GPIO94__FUNC_USB_DRVVBUS>;
			slew-rate = <1>;
			output-low;
		};
	};

	gpio43_mode1_drvvbus_high: drvvbus_high {
		pins_cmd_dat {
			pins = <PINMUX_GPIO94__FUNC_USB_DRVVBUS>;
			slew-rate = <1>;
			output-high;
		};
	};	
};
	
&usb0 {
	pinctrl-names = "iddig_default", "iddig_init";
	pinctrl-0 = <&iddig_default>;
	pinctrl-1 = <&iddig_init>;
	status = "okay";
};

&xhci0 {
	pinctrl-names = "drvvbus_default", "drvvbus_low", "drvvbus_high";
	pinctrl-0 = <&drvvbus_default>;
	pinctrl-1 = <&gpio43_mode1_drvvbus_low>;
	pinctrl-2 = <&gpio43_mode1_drvvbus_high>;
	status = "okay";
};

&touch {
	tpd-resolution = <1080 1920>;
	use-tpd-button = <0>;
	tpd-key-num = <3>;
	tpd-key-local= <139 172 158 0>;
	tpd-key-dim-local = <90 883 100 40 230 883 100 40 370 883 100 40 0 0 0 0>;
	tpd-max-touch-num = <10>;
	tpd-filter-enable = <1>;
	tpd-filter-pixel-density = <192>;
	tpd-filter-custom-prameters = <0 0 0 0 0 0 0 0 0 0 0 0>;
	tpd-filter-custom-speed = <0 0 0>;
	pinctrl-names = "default", "state_eint_as_int", "state_eint_output0", "state_eint_output1",
		"state_rst_output0", "state_rst_output1";
	pinctrl-0 = <&ctp_pins_default>;
	pinctrl-1 = <&ctp_pins_eint_as_int>;
	pinctrl-2 = <&ctp_pins_eint_output0>;
	pinctrl-3 = <&ctp_pins_eint_output1>;
	pinctrl-4 = <&ctp_pins_rst_output0>;
	pinctrl-5 = <&ctp_pins_rst_output1>;
	status = "okay";
};
&pio {
	ctp_pins_default: eint0default {
	};
	ctp_pins_eint_as_int: toucheint@0 {
		pins_cmd_dat {
			pins = <PINMUX_GPIO85__FUNC_EINT8>;
			slew-rate = <0>;
			bias-disable;
		};
	};
	ctp_pins_eint_output0: eintoutput0 {
		pins_cmd_dat {
			pins = <PINMUX_GPIO85__FUNC_GPIO85>;
			slew-rate = <1>;
			output-low;
		};
	};
	ctp_pins_eint_output1: eintoutput1 {
		pins_cmd_dat {
			pins = <PINMUX_GPIO85__FUNC_GPIO85>;
			slew-rate = <1>;
			output-high;
		};
	};
	ctp_pins_rst_output0: rstoutput0 {
		pins_cmd_dat {
			pins = <PINMUX_GPIO68__FUNC_GPIO68>;
			slew-rate = <1>;
			output-low;
		};
	};
	ctp_pins_rst_output1: rstoutput1 {
		pins_cmd_dat {
			pins = <PINMUX_GPIO68__FUNC_GPIO68>;
			slew-rate = <1>;
			output-high;
		};
	};
};
/*TOUCH end*/

/*xielei for spi finger ,gooidx end*/
/* Fingerprint GPIO standardization */
&pio {
       fp_default: default {
       };

       fp_rst_high: fp_rst_high {
               pins_cmd_dat {
                       pins = <PINMUX_GPIO247__FUNC_GPIO247>;
                       slew-rate = <1>;
                       output-high;
               };
       };

       fp_rst_low: fp_rst_low {
               pins_cmd_dat {
                       pins = <PINMUX_GPIO247__FUNC_GPIO247>;
                       slew-rate = <1>;
                       output-low;
               };
       };


       fp_eint_as_int: eint@0 {
               pins_cmd_dat {
                       pins = <PINMUX_GPIO86__FUNC_EINT9>;
                       slew-rate = <0>;
                       bias-disable;
               };
       };
       fp_eint_in_low: eint_in_low {
               pins_cmd_dat {
                       pins = <PINMUX_GPIO86__FUNC_GPIO86>;
                       slew-rate = <0>;
                       bias-pull-down = <00>;
               };
       };
       fp_eint_in_float: eint_in_float {
               pins_cmd_dat {
                       pins = <PINMUX_GPIO86__FUNC_GPIO86>;
                       slew-rate = <0>;
                       bias-disable;
               };
       };
       fp_miso_pull_up: miso_pull_up {
               pins_cmd_dat {
                       pins = <PINMUX_GPIO235__FUNC_GPIO235>;
                       slew-rate = <0>;
                       bias-pull-up = <00>;
               };
       };
       fp_miso_pull_disable: miso_pull_disable {
               pins_cmd_dat {
                       pins = <PINMUX_GPIO235__FUNC_SPI1_MI_B>;
                       bias-disable;
               };
       };
       
       fp_power_low: fp_power_low {
        /*       pins_cmd_dat {
                       pins = <PINMUX_GPIO1__FUNC_GPIO1>;
                       slew-rate = <1>;
                       output-low;
               }; */
       };
       
       fp_power_high: fp_power_high {
        /*      pins_cmd_dat {
                       pins = <PINMUX_GPIO1__FUNC_GPIO1>;
                       slew-rate = <1>;
                       output-high;
               }; */
       };
       
       fp_as_cs_mode: as_cs_mode {
               pins_cmd_dat {
                       pins = <PINMUX_GPIO237__FUNC_SPI1_CS_B>;
                       slew-rate = <0>;
                       bias-pull-up = <00>;
               };
       };
       
       fp_as_ck_mode: as_ck_mode {
               pins_cmd_dat {
                       pins = <PINMUX_GPIO234__FUNC_SPI1_CLK_B>;
                       slew-rate = <0>;
                       bias-pull-down = <00>;
               };
       };
       
       fp_as_mi_mode: as_mi_mode {
               pins_cmd_dat {
                       pins = <PINMUX_GPIO235__FUNC_SPI1_MI_B>;
			           slew-rate = <0>;
			           bias-pull-up = <00>;
                    
               };
       };
       
       fp_as_mo_mode: as_mo_mode {
               pins_cmd_dat {
                       pins = <PINMUX_GPIO236__FUNC_SPI1_MO_B>;
                       slew-rate = <0>;
                       bias-pull-up = <00>;
               };
       };
       
};

&finger {
       pinctrl-names = "fp_default", "finger_rst_high", "finger_rst_low","eint_as_int", "eint_in_low", "eint_in_float", "miso_pull_up",
        "miso_pull_disable","finger_power_low","finger_power_high","finger_mode_as_cs","finger_mode_as_ck","finger_mode_as_mi","finger_mode_as_mo";
       pinctrl-0 = <&fp_default>;
       pinctrl-1 = <&fp_rst_high>;
       pinctrl-2 = <&fp_rst_low>;
       pinctrl-3 = <&fp_eint_as_int>;
       pinctrl-4 = <&fp_eint_in_low>;
       pinctrl-5 = <&fp_eint_in_float>;
       pinctrl-6 = <&fp_miso_pull_up>;
       pinctrl-7 = <&fp_miso_pull_disable>;
       pinctrl-8 = <&fp_power_low>;
       pinctrl-9 = <&fp_power_high>;
       pinctrl-10 = <&fp_as_cs_mode>;
       pinctrl-11 = <&fp_as_ck_mode>;
       pinctrl-12 = <&fp_as_mi_mode>;
       pinctrl-13 = <&fp_as_mo_mode>;
       status = "okay";
};

/* Fingerprint end */




&accdet {
		accdet-mic-vol = <7>;
		headset-mode-setting = <0x500 0x500 1 0x1F0 0x800 0x800 0x20>;
		accdet-plugout-debounce = <1>;
		/*1:ACC mode, 2:low cost without in bias, 6:low cost with in bias*/
		accdet-mic-mode = <1>;
		/*0--MD_MAX--UP_MAX--DW_MAX*/
		headset-three-key-threshold = <0 80 220 400>;
		/*0--MD_MAX--VOICE_MAX--UP_MAX--DW_MAX*/
		headset-four-key-threshold = <0 58 121 192 400>;
		/* ACCDET GPIO standardization ACC mode use */
		pinctrl-names = "default", "state_eint_as_int";
		pinctrl-0 = <&accdet_pins_default>;
		pinctrl-1 = <&accdet_pins_eint_as_int>;
		status = "okay";
};
&pio {
	accdet_pins_default: accdetdefault {
	};
	accdet_pins_eint_as_int: accdeteint@0 {
		pins_cmd_dat {
			pins = <PINMUX_GPIO92__FUNC_EINT15>;
			slew-rate = <0>;
			bias-disable;
		};
	};
};
/*ACCDET end*/
/* mmc start */
&mmc0 {
		clk_src = /bits/ 8 <MSDC0_CLKSRC_400MHZ>;
		bus-width = <8>;
		max-frequency = <200000000>;
		cap-mmc-highspeed;
		msdc-sys-suspend;
		mmc-ddr-1_8v;
		mmc-hs200-1_8v;
		mmc-hs400-1_8v;
		non-removable;
		pinctl = <&mmc0_pins_default>;
		register_setting = <&mmc0_register_setting_default>;
		host_function = /bits/ 8 <MSDC_EMMC>;
		bootable;
		status = "okay";
};

&mmc1 {
		clk_src = /bits/ 8 <MSDC1_CLKSRC_200MHZ>;
		bus-width = <4>;
		max-frequency = <200000000>;
		msdc-sys-suspend;
		cap-sd-highspeed;
		sd-uhs-sdr12;
		sd-uhs-sdr25;
		sd-uhs-sdr50;
		sd-uhs-sdr104;
		/* sd-uhs-ddr50;*/
		pinctl = <&mmc1_pins_default>;
		pinctl_sdr104 = <&mmc1_pins_sdr104>;
		pinctl_sdr50 = <&mmc1_pins_sdr50>;
		pinctl_ddr50 = <&mmc1_pins_ddr50>;
		register_setting = <&mmc1_register_setting_default>;
		host_function = /bits/ 8 <MSDC_SD>;
		cd_level = /bits/ 8 <MSDC_CD_LOW>;
		cd-gpios = <&pio 67 0>;
		status = "okay";
};
/* AUDIO GPIO standardization */
&audgpio {
	pinctrl-names = "aud_clk_mosi_off",
			"aud_clk_mosi_on",
			"aud_smartpa_mode0",
			"aud_smartpa_mode1",
			"aud_smartpa_mode3",
			"aud_tdm_mode0",
			"aud_tdm_mode1",
			"hpdepop-pullhigh",
			"hpdepop-pulllow",
			"aud_dat_miso_off",
			"aud_dat_miso_on",
			"aud_dat_mosi_off",
			"aud_dat_mosi_on",
			"vow_dat_miso_off",
			"vow_dat_miso_on",
			"vow_clk_miso_off",
			"vow_clk_miso_on",
			"anc_dat_mosi_off",
			"anc_dat_mosi_on",
			"hpdepop-pullhigh_e2",
			"hpdepop-pulllow_e2";
	pinctrl-0 = <&aud_clk_mosi_off>;
	pinctrl-1 = <&aud_clk_mosi_on>;
	pinctrl-2 = <&aud_pins_smartpa_mode0>;
	pinctrl-3 = <&aud_pins_smartpa_mode1>;
	pinctrl-4 = <&aud_pins_smartpa_mode3>;
	pinctrl-5 = <&aud_pins_tdm_mode0>;
	pinctrl-6 = <&aud_pins_tdm_mode1>;
	pinctrl-7 = <&aud_pins_hpdepop_high>;
	pinctrl-8 = <&aud_pins_hpdepop_low>;
	pinctrl-9 = <&aud_dat_miso_off>;
	pinctrl-10 = <&aud_dat_miso_on>;
	pinctrl-11 = <&aud_dat_mosi_off>;
	pinctrl-12 = <&aud_dat_mosi_on>;
	pinctrl-13 = <&vow_dat_miso_off>;
	pinctrl-14 = <&vow_dat_miso_on>;
	pinctrl-15 = <&vow_clk_miso_off>;
	pinctrl-16 = <&vow_clk_miso_on>;
	pinctrl-17 = <&anc_dat_mosi_off>;
	pinctrl-18 = <&anc_dat_mosi_on>;
	pinctrl-19 = <&aud_pins_hpdepop_high_e2>;
	pinctrl-20 = <&aud_pins_hpdepop_low_e2>;
	status = "okay";
};

&pio {
	aud_clk_mosi_off: aud_clk_mosi_off {
		pins_cmd0_dat {
			pins = <PINMUX_GPIO146__FUNC_GPIO146>;
		};
	};

	aud_clk_mosi_on: aud_clk_mosi_on {
		pins_cmd0_dat {
			pins = <PINMUX_GPIO146__FUNC_AUD_CLK_MOSI>;
		};
	};

	aud_pins_smartpa_mode0: aud_pins_smartpa_mode0 {
		pins_cmd0_dat {
			pins = <PINMUX_GPIO69__FUNC_GPIO69>;
		};
		pins_cmd1_dat {
			pins = <PINMUX_GPIO70__FUNC_GPIO70>;
		};
		pins_cmd2_dat {
			pins = <PINMUX_GPIO72__FUNC_GPIO72>;
		};
		pins_cmd3_dat {
			pins = <PINMUX_GPIO73__FUNC_GPIO73>;
		};
	};

	aud_pins_smartpa_mode1: aud_pins_smartpa_mode1 {
		pins_cmd0_dat {
			pins = <PINMUX_GPIO69__FUNC_I2S3_LRCK>;
		};
		pins_cmd1_dat {
			pins = <PINMUX_GPIO70__FUNC_I2S3_BCK>;
		};
		pins_cmd2_dat {
			pins = <PINMUX_GPIO72__FUNC_I2S0_DI>;
		};
		pins_cmd3_dat {
			pins = <PINMUX_GPIO73__FUNC_I2S3_DO>;
		};
	};

	aud_pins_smartpa_mode3: aud_pins_smartpa_mode3 {
		pins_cmd0_dat {
			pins = <PINMUX_GPIO69__FUNC_I2S3_LRCK>;
		};
		pins_cmd1_dat {
			pins = <PINMUX_GPIO70__FUNC_I2S3_BCK>;
		};
		pins_cmd2_dat {
			pins = <PINMUX_GPIO72__FUNC_I2S0_DI>;
		};
		pins_cmd3_dat {
			pins = <PINMUX_GPIO73__FUNC_I2S3_DO>;
		};
	};

	aud_pins_tdm_mode0: aud_pins_tdm_mode0 {
		pins_cmd0_dat {
			pins = <PINMUX_GPIO135__FUNC_GPIO135>;
		};
		pins_cmd1_dat {
			pins = <PINMUX_GPIO136__FUNC_GPIO136>;
		};
		pins_cmd2_dat {
			pins = <PINMUX_GPIO138__FUNC_GPIO138>;
		};
	};

	aud_pins_tdm_mode1: aud_pins_tdm_mode1 {
		pins_cmd0_dat {
			pins = <PINMUX_GPIO135__FUNC_TDM_LRCK>;
		};
		pins_cmd1_dat {
			pins = <PINMUX_GPIO136__FUNC_TDM_BCK>;
		};
		pins_cmd2_dat {
			pins = <PINMUX_GPIO138__FUNC_TDM_DATA0>;
		};
	};

	aud_pins_hpdepop_high: audhpdepophigh {
		pins_cmd_dat {
			pins = <PINMUX_GPIO111__FUNC_GPIO111>;
			slew-rate = <1>;
			output-high;
		};
	};

	aud_pins_hpdepop_low: audhpdepoplow {
		pins_cmd_dat {
			pins = <PINMUX_GPIO111__FUNC_GPIO111>;
			slew-rate = <1>;
			output-low;
		};
	};

	aud_pins_hpdepop_high_e2: audhpdepophigh_e2 {
		pins_cmd_dat {
			pins = <PINMUX_GPIO254__FUNC_GPIO254>;
			slew-rate = <1>;
			output-high;
		};
	};

	aud_pins_hpdepop_low_e2: audhpdepoplow_e2 {
		pins_cmd_dat {
			pins = <PINMUX_GPIO254__FUNC_GPIO254>;
			slew-rate = <1>;
			output-low;
		};
	};

	aud_dat_miso_off: aud_dat_miso_off {
		pins_cmd1_dat {
			pins = <PINMUX_GPIO147__FUNC_GPIO147>;
		};
	};
	aud_dat_miso_on: aud_dat_miso_on {
		pins_cmd1_dat {
			pins = <PINMUX_GPIO147__FUNC_AUD_DAT_MISO>;
		};
	};

	aud_dat_mosi_off: aud_dat_mosi_off {
		pins_cmd2_dat {
			pins = <PINMUX_GPIO148__FUNC_GPIO148>;
		};
	};
	aud_dat_mosi_on: aud_dat_mosi_on {
		pins_cmd2_dat {
			pins = <PINMUX_GPIO148__FUNC_AUD_DAT_MOSI>;
		};
	};

	vow_dat_miso_off: vow_dat_miso_off {
		pins_cmd1_dat {
			pins = <PINMUX_GPIO147__FUNC_GPIO147>;
		};
	};
	vow_dat_miso_on: vow_dat_miso_on {
		pins_cmd1_dat {
			pins = <PINMUX_GPIO147__FUNC_VOW_DAT_MISO>;
		};
	};

	vow_clk_miso_off: vow_clk_miso_off {
		pins_cmd3_dat {
			pins = <PINMUX_GPIO149__FUNC_GPIO149>;
		};
	};
	vow_clk_miso_on: vow_clk_miso_on {
		pins_cmd3_dat {
			pins = <PINMUX_GPIO149__FUNC_VOW_CLK_MISO>;
		};
	};

	anc_dat_mosi_off: anc_dat_mosi_off {
		pins_cmd4_dat {
			pins = <PINMUX_GPIO150__FUNC_GPIO150>;
		};
	};
	anc_dat_mosi_on: anc_dat_mosi_on {
		pins_cmd4_dat {
			pins = <PINMUX_GPIO150__FUNC_ANC_DAT_MOSI>;
		};
	};


};
/* AUDIO end */

/* DISPSYS GPIO start */
&mtkfb {
	pinctrl-names = "mode_te_gpio", "mode_te_te", "lcm_rst_out0_gpio",
			"lcm_rst_out1_gpio", "lcd_bias_enp0_gpio", "lcd_bias_enp1_gpio";
	pinctrl-0 = <&mtkfb_pins_mode_te_gpio>;
	pinctrl-1 = <&mtkfb_pins_mode_te_te>;
	pinctrl-2 = <&mtkfb_pins_lcm_reset0>;
	pinctrl-3 = <&mtkfb_pins_lcm_reset1>;
	pinctrl-4 = <&mtkfb_pins_lcd_bias_enp0>;
	pinctrl-5 = <&mtkfb_pins_lcd_bias_enp1>;
	status = "okay";
};

&pio {

	mtkfb_pins_mode_te_gpio: mode_te_gpio {
		pins_cmd_dat {
			pins = <PINMUX_GPIO179__FUNC_DSI_TE0>;
		};
	};

	mtkfb_pins_mode_te_te: mode_te_te {
		pins_cmd_dat {
			pins = <PINMUX_GPIO179__FUNC_DSI_TE0>;
		};
	};

	mtkfb_pins_lcm_reset0: lcm_rst_out0_gpio {
		pins_cmd_dat {
			pins = <PINMUX_GPIO180__FUNC_LCM_RST>;
			slew-rate = <1>;
			output-low;
		};
	};

	mtkfb_pins_lcm_reset1: lcm_rst_out1_gpio {
		pins_cmd_dat {
			pins = <PINMUX_GPIO180__FUNC_LCM_RST>;
			slew-rate = <1>;
			output-high;
		};
	};

	mtkfb_pins_lcd_bias_enp0: lcd_bias_enp0_gpio {
		pins_cmd_dat {
			pins = <PINMUX_GPIO65__FUNC_GPIO65>;
			slew-rate = <1>;
			output-low;
		};
	};

	mtkfb_pins_lcd_bias_enp1: lcd_bias_enp1_gpio {
		pins_cmd_dat {
			pins = <PINMUX_GPIO65__FUNC_GPIO65>;
			slew-rate = <1>;
			output-high;
		};
	};
};
/* DISPSYS GPIO end */
/* CAMERA GPIO standardization */
&pio {
	camera_pins_cam0_rst0: cam0@0 {
		pins_cmd_dat {
			pins = <PINMUX_GPIO32__FUNC_GPIO32>;
			slew-rate = <1>; /*direction 0:in, 1:out*/
			output-low;/*direction out used only. output_low or high*/
		};
	};
	camera_pins_cam0_rst1: cam0@1 {
		pins_cmd_dat {
			pins = <PINMUX_GPIO32__FUNC_GPIO32>;
			slew-rate = <1>;
			output-high;
		};
	};
	camera_pins_cam0_pnd0: cam0@2 {
		pins_cmd_dat {
			pins = <PINMUX_GPIO28__FUNC_GPIO28>;
			slew-rate = <1>;
			output-low;
		};
	};
	camera_pins_cam0_pnd1: cam0@3 {
		pins_cmd_dat {
			pins = <PINMUX_GPIO28__FUNC_GPIO28>;
			slew-rate = <1>;
			output-high;
		};
	};
	camera_pins_cam3_rst0: cam3@0 {
		pins_cmd_dat {
			pins = <PINMUX_GPIO40__FUNC_GPIO40>;
			slew-rate = <1>; /*direction 0:in, 1:out*/
			output-low;/*direction out used only. output_low or high*/
		};
	};
	camera_pins_cam3_rst1: cam3@1 {
		pins_cmd_dat {
			pins = <PINMUX_GPIO40__FUNC_GPIO40>;
			slew-rate = <1>;
			output-high;
		};
	};
	camera_pins_cam3_pnd0: cam3@2 {
		pins_cmd_dat {
			pins = <PINMUX_GPIO39__FUNC_GPIO39>;
			slew-rate = <1>;
			output-low;
		};
	};
	camera_pins_cam3_pnd1: cam3@3 {
		pins_cmd_dat {
			pins = <PINMUX_GPIO39__FUNC_GPIO39>;
			slew-rate = <1>;
			output-high;
		};
	};	
	camera_pins_cam1_rst0: cam1@0 {
		pins_cmd_dat {
			pins = <PINMUX_GPIO33__FUNC_GPIO33>;
			slew-rate = <1>; /*direction 0:in, 1:out*/
			output-low;/*direction out used only. output_low or high*/
		};
	};
	camera_pins_cam1_rst1: cam1@1 {
		pins_cmd_dat {
			pins = <PINMUX_GPIO33__FUNC_GPIO33>;
			slew-rate = <1>;
			output-high;
		};
	};
	camera_pins_cam1_pnd0: cam1@2 {
		pins_cmd_dat {
			pins = <PINMUX_GPIO29__FUNC_GPIO29>;
			slew-rate = <1>;
			output-low;
		};
	};
	camera_pins_cam1_pnd1: cam1@3 {
		pins_cmd_dat {
			pins = <PINMUX_GPIO29__FUNC_GPIO29>;
			slew-rate = <1>;
			output-high;
		};
	};
	camera_pins_cam2_rst0: cam2@0 {
		pins_cmd_dat {
			pins = <PINMUX_GPIO35__FUNC_GPIO35>;
			slew-rate = <1>; /*direction 0:in, 1:out*/
			output-low;/*direction out used only. output_low or high*/
		};
	};
	camera_pins_cam2_rst1: cam2@1 {
		pins_cmd_dat {
			pins = <PINMUX_GPIO35__FUNC_GPIO35>;
			slew-rate = <1>;
			output-high;
		};
	};
	camera_pins_cam2_pnd0: cam2@2 {
		pins_cmd_dat {
			pins = <PINMUX_GPIO34__FUNC_GPIO34>;
			slew-rate = <1>;
			output-low;
		};
	};
	camera_pins_cam2_pnd1: cam2@3 {
		pins_cmd_dat {
			pins = <PINMUX_GPIO34__FUNC_GPIO34>;
			slew-rate = <1>;
			output-high;
		};
	};
	camera_pins_cam_ldo_vcama_0: cam0@vcama0 {
		pins_cmd_dat {
			pins = <PINMUX_GPIO135__FUNC_GPIO135>;
			slew-rate = <1>;
			output-low;
		};
	};
	camera_pins_cam_ldo_vcama_1: cam1@vcama1 {
		pins_cmd_dat {
			pins = <PINMUX_GPIO135__FUNC_GPIO135>;
			slew-rate = <1>;
			output-high;
		};
	};
	camera_pins_cam_ldo_vcamd_0: cam0@vcamd0 {
		pins_cmd_dat {
			pins = <PINMUX_GPIO137__FUNC_GPIO137>;
			slew-rate = <1>;
			output-low;
		};
	};
	camera_pins_cam_ldo_vcamd_1: cam1@vcamd1 {
		pins_cmd_dat {
			pins = <PINMUX_GPIO137__FUNC_GPIO137>;
			slew-rate = <1>;
			output-high;
		};
	};

	camera_pins_cam2_ldo_vcama_0: cam0@vcama2 {
		pins_cmd_dat {
			pins = <PINMUX_GPIO140__FUNC_GPIO140>;
			slew-rate = <1>;
			output-low;
		};
	};
	camera_pins_cam2_ldo_vcama_1: cam1@vcama3 {
		pins_cmd_dat {
			pins = <PINMUX_GPIO140__FUNC_GPIO140>;
			slew-rate = <1>;
			output-high;
		};
	};
	camera_pins_cam2_ldo_vcamd_0: cam2@vcamd2 {
		pins_cmd_dat {
			pins = <PINMUX_GPIO136__FUNC_GPIO136>;
			slew-rate = <1>;
			output-low;
		};
	};
	camera_pins_cam2_ldo_vcamd_1: cam2@vcamd3 {
		pins_cmd_dat {
			pins = <PINMUX_GPIO136__FUNC_GPIO136>;
			slew-rate = <1>;
			output-high;
		};
	};
	camera_pins_cam_mipi_switch_en_low: cam0@mipien0 {
		pins_cmd_dat {
			pins = <PINMUX_GPIO87__FUNC_GPIO87>;
			slew-rate = <1>;
			output-low;
		};
	};
	camera_pins_cam_mipi_switch_en_high: cam1@mipien1 {
		pins_cmd_dat {
			pins = <PINMUX_GPIO87__FUNC_GPIO87>;
			slew-rate = <1>;
			output-high;
		};
	};	
	camera_pins_cam_mipi_switch_sel_low: cam0@mipisel0 {
		pins_cmd_dat {
			pins = <PINMUX_GPIO62__FUNC_GPIO62>;
			slew-rate = <1>;
			output-low;
		};
	};
	camera_pins_cam_mipi_switch_sel_high: cam1@mipisel1 {
		pins_cmd_dat {
			pins = <PINMUX_GPIO62__FUNC_GPIO62>;
			slew-rate = <1>;
			output-high;
		};
	};	
	
	camera_pins_default: camdefault {
	};
};

&kd_camera_hw1 {
	pinctrl-names = "default",
			"cam0_rst0", "cam0_rst1", "cam0_pnd0", "cam0_pnd1",
			"cam1_rst0", "cam1_rst1", "cam1_pnd0", "cam1_pnd1",
			"cam2_rst0", "cam2_rst1", "cam2_pnd0", "cam2_pnd1",
			"cam_ldo_vcama_0", "cam_ldo_vcama_1", "cam_ldo_vcamd_0", "cam_ldo_vcamd_1",
			"cam2_ldo_vcama_0", "cam2_ldo_vcama_1", "cam2_ldo_vcamd_0", "cam2_ldo_vcamd_1",
			"cam_mipi_switch_en_0", "cam_mipi_switch_en_1", "cam_mipi_switch_sel_0", "cam_mipi_switch_sel_1",
			"cam3_rst0", "cam3_rst1", "cam3_pnd0", "cam3_pnd1";
	pinctrl-0 = <&camera_pins_default>;
	pinctrl-1 = <&camera_pins_cam0_rst0>;
	pinctrl-2 = <&camera_pins_cam0_rst1>;
	pinctrl-3 = <&camera_pins_cam0_pnd0>;
	pinctrl-4 = <&camera_pins_cam0_pnd1>;
	pinctrl-5 = <&camera_pins_cam1_rst0>;
	pinctrl-6 = <&camera_pins_cam1_rst1>;
	pinctrl-7 = <&camera_pins_cam1_pnd0>;
	pinctrl-8 = <&camera_pins_cam1_pnd1>;
	/* for main2 */
	pinctrl-9 = <&camera_pins_cam2_rst0>;
	pinctrl-10 = <&camera_pins_cam2_rst1>;
	pinctrl-11 = <&camera_pins_cam2_pnd0>;
	pinctrl-12 = <&camera_pins_cam2_pnd1>;
	/* for ldo control by gpio */
	pinctrl-13 = <&camera_pins_cam_ldo_vcama_0>;
	pinctrl-14 = <&camera_pins_cam_ldo_vcama_1>;
	pinctrl-15 = <&camera_pins_cam_ldo_vcamd_0>;
	pinctrl-16 = <&camera_pins_cam_ldo_vcamd_1>;
	pinctrl-17 = <&camera_pins_cam2_ldo_vcama_0>;
	pinctrl-18 = <&camera_pins_cam2_ldo_vcama_1>;
	pinctrl-19 = <&camera_pins_cam2_ldo_vcamd_0>;
	pinctrl-20 = <&camera_pins_cam2_ldo_vcamd_1>;
	pinctrl-21 = <&camera_pins_cam_mipi_switch_en_low>;
	pinctrl-22 = <&camera_pins_cam_mipi_switch_en_high>;
	pinctrl-23 = <&camera_pins_cam_mipi_switch_sel_low>;
	pinctrl-24 = <&camera_pins_cam_mipi_switch_sel_high>;	
	pinctrl-25 = <&camera_pins_cam3_rst0>;
	pinctrl-26 = <&camera_pins_cam3_rst1>;
	pinctrl-27 = <&camera_pins_cam3_pnd0>;
	pinctrl-28 = <&camera_pins_cam3_pnd1>;	
	status = "okay";
};
/* CAMERA GPIO end */

/* CONSYS GPIO standardization */
&pio {
	consys_pins_default: default {

	};

	gpslna_pins_init: gpslna@0 {

	    pins_cmd_dat {
			pins = <PINMUX_GPIO141__FUNC_GPIO141>;
			slew-rate = <0>;
			bias-disable;
			output-low;
		};
	};

	gpslna_pins_oh: gpslna@1 {

	    pins_cmd_dat {
			pins = <PINMUX_GPIO141__FUNC_GPIO141>;
			slew-rate = <1>;
			output-high;
		};
	};

	gpslna_pins_ol: gpslna@2 {

	    pins_cmd_dat {
			pins = <PINMUX_GPIO141__FUNC_GPIO141>;
			slew-rate = <1>;
			output-low;
		};
	};

};

&consys {
	pinctrl-names = "default", "gps_lna_state_init", "gps_lna_state_oh", "gps_lna_state_ol";
	pinctrl-0 = <&consys_pins_default>;
	pinctrl-1 = <&gpslna_pins_init>;
	pinctrl-2 = <&gpslna_pins_oh>;
	pinctrl-3 = <&gpslna_pins_ol>;
	status = "okay";

};
/* CONSYS end */


/* FLASHLIGHT GPIO standardization */
&pio {
	flashlight_pins_default: default {

	};

	flashlight_pins_hwen_high: hwen_high {

	    pins_cmd_dat {
			pins = <PINMUX_GPIO256__FUNC_GPIO256>;
			slew-rate = <1>;
			output-high;
		};
	};

	flashlight_pins_hwen_low: hwen_low {

	    pins_cmd_dat {
			pins = <PINMUX_GPIO256__FUNC_GPIO256>;
			slew-rate = <1>;
			output-low;
		};
	};

	flashlight_pins_torch_high: torch_high {

	    pins_cmd_dat {
			pins = <PINMUX_GPIO255__FUNC_GPIO255>;
			slew-rate = <1>;
			output-high;
		};
	};

	flashlight_pins_torch_low: torch_low {

	    pins_cmd_dat {
			pins = <PINMUX_GPIO255__FUNC_GPIO255>;
			slew-rate = <1>;
			output-low;
		};
	};	
	
};

&flashlight {
	pinctrl-names = "default", "hwen_high", "hwen_low", "torch_high", "torch_low";
	pinctrl-0 = <&flashlight_pins_default>;
	pinctrl-1 = <&flashlight_pins_hwen_high>;
	pinctrl-2 = <&flashlight_pins_hwen_low>;
	pinctrl-3 = <&flashlight_pins_torch_high>;
	pinctrl-4 = <&flashlight_pins_torch_low>;	
	status = "okay";

};
/* FLASHLIGHT GPIO end */

/* irtx GPIO standardization */
&irtx {
	pinctrl-names = "irtx_gpio_default",
			"irtx_gpio_led_set";
	pinctrl-0 = <&irtx_gpio_default>;
	pinctrl-1 = <&irtx_gpio_led_set>;
	status = "okay";
};

&pio {
	/* IRTX GPIO Settings -Start */
	/* default: GPIO0, output, high */
	irtx_gpio_default:irtx_gpio_led_def@gpio138 {
		pins_cmd_dat {
			pins = <PINMUX_GPIO138__FUNC_GPIO138>;   
			slew-rate = <0>;
			bias-pull-down = <00>;
			input-schmitt-enable = <0>;
		};
	};
	irtx_gpio_led_set:irtx_gpio_led_set@gpio138 {
		pins_cmd_dat {
			pins = <PINMUX_GPIO138__FUNC_GPIO138>;  
		};
	};
	/* IRTX GPIO Settings -End */
};

/* LCM GPIO Kernal Standardization start */
&lcm_mode {
	pinctrl-names = "default", "lcm_mode_00", "lcm_mode_01", "lcm_mode_02", "lcm_mode_03", "lcm_mode_04",
	 "lcm_mode_05", "lcm_mode_07";
	pinctrl-0 = <&lcm_mode_default>;
	pinctrl-1 = <&lcm_mode_00>;
	pinctrl-2 = <&lcm_mode_01>;
	pinctrl-3 = <&lcm_mode_02>;
	pinctrl-4 = <&lcm_mode_03>;
	pinctrl-5 = <&lcm_mode_04>;
	pinctrl-6 = <&lcm_mode_05>;
	pinctrl-8 = <&lcm_mode_07>;
	lcm_power_gpio = <&pio 62 0>;
	lcm_bl_gpio = <&pio 62 0>;
	status = "okay";
};

&pio {
	lcm_mode_default: lcm_mode_default {
		pins_cmd_dat {
			pins = <PINMUX_GPIO62__FUNC_GPIO62>;
		};
	};

	lcm_mode_00: lcm_mode@0 {
		pins_cmd_dat {
			pins = <PINMUX_GPIO62__FUNC_GPIO62>;
		};
	};

	lcm_mode_01: lcm_mode@1 {
		pins_cmd_dat {
			pins = <PINMUX_GPIO62__FUNC_GPIO62>;
		};
	};

	lcm_mode_02: lcm_mode@2 {
		pins_cmd_dat {
			pins = <PINMUX_GPIO62__FUNC_GPIO62>;
		};
	};

	lcm_mode_03: lcm_mode@3 {
		pins_cmd_dat {
			pins = <PINMUX_GPIO62__FUNC_GPIO62>;
		};
	};

	lcm_mode_04: lcm_mode@4 {
		pins_cmd_dat {
			pins = <PINMUX_GPIO62__FUNC_GPIO62>;
		};
	};

	lcm_mode_05: lcm_mode@5 {
		pins_cmd_dat {
			pins = <PINMUX_GPIO62__FUNC_GPIO62>;
		};
	};

	lcm_mode_07: lcm_mode@7 {
		pins_cmd_dat {
			pins = <PINMUX_GPIO62__FUNC_GPIO62>;
		};
	};
};
/* LCM GPIO Kernal Standardization end */



/* SCP GPIO standardization */

&pio {
	scp_dvfs_default: default {
	};
	scp_aud_clk_mosi_off: scp_gpio_off {
		pins_cmd_dat {
			pins = <PINMUX_GPIO146__FUNC_GPIO146>;
		};
	};

	scp_aud_clk_mosi_on: scp_gpio_on {
		pins_cmd_dat {
			pins = <PINMUX_GPIO146__FUNC_AUD_CLK_MOSI>;
		};
	};
};

&scpdvfs {
	pinctrl-names = "default", "scp_gpio_off", "scp_gpio_on";
	pinctrl-0 = <&scp_dvfs_default>;
	pinctrl-1 = <&scp_aud_clk_mosi_off>;
	pinctrl-2 = <&scp_aud_clk_mosi_on>;
	status = "okay";
};

/* SCP DVFS GPIO end */
/* DA9214 GPIO Start */
&ext_buck_vproc {
	pinctrl-names = "da9214_gpio_default";
	pinctrl-0 = <&da9214_gpio_default>;
	status = "okay";
};

&pio {
	/* DA9214 GPIO Settings -Start */
	/* default: GPIO61, output, low */
	da9214_gpio_default:da9214_gpio_def@gpio61 {
		pins_cmd_dat {
			pins = <PINMUX_GPIO61__FUNC_GPIO61>;
			slew-rate = <1>;
			bias-disable;
			output-low;
			input-schmitt-enable = <0>;
		};
	};
	/* DA9214 GPIO Settings -End */
};
/* DA9214 GPIO End */

/* temp sne GPIO standardization */
&pio {
	temp_wake_up_default: wake_up_default {
			pins_cmd_dat {
			pins = <PINMUX_GPIO241__FUNC_SCL5_0>;
			slew-rate = <0>;
		};
	};
	
	temp_wake_up_low: state_wake_up_low {
		pins_cmd_dat {
			pins = <PINMUX_GPIO241__FUNC_GPIO241>;
			slew-rate = <1>;
			output-low;
		};
	};

	temp_power_on_low: state_power_on_low {
		pins_cmd_dat {
			pins = <PINMUX_GPIO93__FUNC_GPIO93>;
			slew-rate = <1>;
			output-low;
		};
	};
	
	temp_power_on_high: state_power_on_high {
		pins_cmd_dat {
			pins = <PINMUX_GPIO93__FUNC_GPIO93>;
			slew-rate = <1>;
			output-high;
		};
	};	
	
	};
	
&temp {
	pinctrl-names = "default","wake_up_low","power_on_low","power_on_high";
	pinctrl-0 = <&temp_wake_up_default>;
	pinctrl-1 = <&temp_wake_up_low>;
	pinctrl-2 = <&temp_power_on_low>;
	pinctrl-3 = <&temp_power_on_high>;	
    status = "okay";
	};
